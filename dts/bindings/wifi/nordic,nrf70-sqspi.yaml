## dts/bindings/wifi/nordic,nrf70-sqspi.yaml
```yaml
# Copyright (c) 2024 Nordic Semiconductor ASA
# SPDX-License-Identifier: Apache-2.0

description: nRF70 Wi-Fi chip with sQSPI interface.

include: ["nordic,nrf70.yaml", "mspi-device.yaml", "base.yaml"]
```

## dts/bindings/wifi/nordic,nrf7002-sqspi.yaml
```yaml
# Copyright (c) 2024 Nordic Semiconductor ASA
# SPDX-License-Identifier: Apache-2.0

description: nRF7002 Wi-Fi chip with sQSPI interface.

compatible: nordic,nrf7002-sqspi

include:
  - "nordic,nrf70-sqspi.yaml"
  - "wifi-tx-power-2g.yaml"
  - "wifi-tx-power-5g.yaml"
```
